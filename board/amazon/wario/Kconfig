## board/amazon/wario/Kconfig
```kconfig
if TARGET_WARIO

config SYS_BOARD
	default "wario"

config SYS_VENDOR
	default "amazon"

config SYS_CONFIG_NAME
	default "wario"

endif
```

## configs/wario_defconfig
```kconfig
CONFIG_ARM=y
CONFIG_ARCH_MX6=y
CONFIG_SYS_TEXT_BASE=0x87800000
CONFIG_ENV_SIZE=0x2000
CONFIG_ENV_OFFSET=0x80000
CONFIG_MX6SL=y
CONFIG_TARGET_WARIO=y
CONFIG_NR_DRAM_BANKS=1
CONFIG_SYS_EXTRA_OPTIONS="IMX_CONFIG=arch/arm/mach-imx/spl_sd.cfg"
CONFIG_SUPPORT_RAW_INITRD=y
CONFIG_HUSH_PARSER=y
CONFIG_ENV_IS_IN_MMC=y
CONFIG_SYS_MMC_ENV_DEV=1
CONFIG_SYS_RELOC_GD_ENV_ADDR=y
CONFIG_NET=n
CONFIG_DISTRO_DEFAULTS=y

CONFIG_SPL=y
CONFIG_SPL_TEXT_BASE=0x00908000
CONFIG_SPL_LIBCOMMON_SUPPORT=y
CONFIG_SPL_LIBGENERIC_SUPPORT=y
CONFIG_SPL_SERIAL_SUPPORT=y
CONFIG_SPL_USB_HOST_SUPPORT=y
CONFIG_SPL_USB_SDP_SUPPORT=y
CONFIG_SPL_USB_GADGET=y
CONFIG_SPL_WATCHDOG_SUPPORT=y
CONFIG_SPL_MMC_SUPPORT=y
CONFIG_SPL_MMC_TINY=y
CONFIG_SPL_SEPARATE_BSS=y
CONFIG_SPL_EARLY_BSS=y

CONFIG_CMD_BOOTMENU=y
CONFIG_CMD_BOOTZ=y
CONFIG_CMD_DM=y
CONFIG_CMD_MMC=y
CONFIG_CMD_USB=y
CONFIG_CMD_EXT2=y
CONFIG_CMD_EXT4=y
CONFIG_CMD_EXT4_WRITE=y
CONFIG_CMD_FAT=y
CONFIG_CMD_FS_GENERIC=y
CONFIG_CMD_PMIC=y
CONFIG_CMD_I2C=y
CONFIG_CMD_REGULATOR=y

CONFIG_OF_CONTROL=y
CONFIG_OF_LIBFDT=y
CONFIG_DEFAULT_DEVICE_TREE="wario"
CONFIG_DM=y
CONFIG_DM_GPIO=y
CONFIG_DM_MMC=y
CONFIG_DM_PWM=y
CONFIG_DM_REGULATOR=y
CONFIG_DM_REGULATOR_FIXED=y
CONFIG_DM_SERIAL=y
CONFIG_DM_THERMAL=y
CONFIG_DM_USB=y
CONFIG_DM_I2C=y
CONFIG_DM_PMIC=y
CONFIG_DM_PMIC_MAX77696=y
CONFIG_DM_REGULATOR_MAX77696=y

CONFIG_BACKLIGHT=y
CONFIG_BACKLIGHT_PWM=y
CONFIG_CI_UDC=y
CONFIG_MMC=y
CONFIG_FSL_USDHC=y
CONFIG_PINCTRL=y
CONFIG_PINCTRL_IMX6=y
CONFIG_IMX_THERMAL=y
CONFIG_MXC_UART=y
CONFIG_SYS_I2C_MXC=y
CONFIG_PWM_MAX77696=y
CONFIG_USB=y
CONFIG_USB_HOST=y
CONFIG_USB_GADGET=y
CONFIG_USB_GADGET_MANUFACTURER="FSL"
CONFIG_USB_GADGET_VENDOR_NUM=0x0525
CONFIG_USB_GADGET_PRODUCT_NUM=0xa4a5
CONFIG_USB_GADGET_DOWNLOAD=y
CONFIG_CMD_USB_MASS_STORAGE=y
```
